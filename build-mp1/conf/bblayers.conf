## build-mp1/conf/bblayers.conf
```bitbake
# POKY_BBLAYERS_CONF_VERSION is increased each time build/conf/bblayers.conf
# changes incompatibly
POKY_BBLAYERS_CONF_VERSION = "2"

BBPATH = "${TOPDIR}"
BBFILES ?= ""

BBLAYERS ?= " \
  /home/kjlau0112/stm32_sato/Stargazer-OS/poky/meta \
  /home/kjlau0112/stm32_sato/Stargazer-OS/poky/meta-poky \
  /home/kjlau0112/stm32_sato/Stargazer-OS/poky/meta-yocto-bsp \
  /home/kjlau0112/stm32_sato/Stargazer-OS/meta-openembedded/meta-oe \
  /home/kjlau0112/stm32_sato/Stargazer-OS/meta-openembedded/meta-python \
  /home/kjlau0112/stm32_sato/Stargazer-OS/meta-st-stm32mp \
  /home/kjlau0112/stm32_sato/Stargazer-OS/meta-distro-stargazer \
 "
```

## meta-distro-stargazer/conf/distro/stargazer.conf
```bitbake
require conf/distro/poky.conf
DISTRO = "stargazer"
DISTRO_NAME = "Stargazer OS"
DISTRO_VERSION = "1.2.2"
MAINTAINER = "lkarnjye@gmail.com"
```

## meta-kjlau/conf/layer.conf
```bitbake
# We have a conf and classes directory, add to BBPATH
BBPATH .= ":${LAYERDIR}"

# We have recipes-* directories, add to BBFILES
BBFILES += "${LAYERDIR}/recipes-*/*/*.bb \
            ${LAYERDIR}/recipes-*/*/*.bbappend"

BBFILE_COLLECTIONS += "meta-kjlau"
BBFILE_PATTERN_meta-kjlau = "^${LAYERDIR}/"
BBFILE_PRIORITY_meta-kjlau = "7"

LAYERDEPENDS_meta-kjlau = "core"
LAYERSERIES_COMPAT_meta-kjlau = "dunfell"
```
